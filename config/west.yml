## config/west.yml
```yaml
manifest:
  remotes:
    - name: zmkfirmware
      url-base: https://github.com/zmkfirmware
    - name: caksoylar
      url-base: https://github.com/caksoylar
  projects:
    - name: zmk
      remote: zmkfirmware
      revision: main
#      remote: caksoylar
#      revision: caksoylar/zen-unified
      import: app/west.yml
  self:
    path: config
```
